## meta-cat-guardian/conf/layer.conf
```bitbake
BBPATH .= ":${LAYERDIR}"

BBFILES += "${LAYERDIR}/recipes-*/*/*.bb \
            ${LAYERDIR}/recipes-*/*/*.bbappend"

BBFILE_COLLECTIONS += "cat-guardian"
BBFILE_PATTERN_cat-guardian = "^${LAYERDIR}/"
BBFILE_PRIORITY_cat-guardian = "6"

LAYERSERIES_COMPAT_cat-guardian = "wrynose"
```
